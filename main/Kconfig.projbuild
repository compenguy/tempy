## main/Kconfig.projbuild
```kconfig
menu "Tempy Configuration"

    config TEMPY_SLEEP_BETWEEN_READINGS
        bool "Sleep between taking sensor readings"
        depends on FREERTOS_USE_TICKLESS_IDLE
        default n
        help
            This puts the board into light sleep between taking sensor readings.
            This will have the effect of disabling serial debug as well.

    config TEMPY_DELAY_BETWEEN_SENSOR_READINGS_MS
        int "Delay from taking one sensor reading until the next, in milliseconds"
        default 60000
        help
            The time from completing one sensor reading before taking the next one.
            Lower numbers will provide more frequent updates, while higher numbers will
            extend the battery life. Recommended values are between 2000 (2 seconds)
            and 180000 (3 minutes).

    config TEMPY_BME280_I2C_SDA_PIN
        int "I2C SDA Pin"
        default 13
        help
            GPIO number for I2C master data

    config TEMPY_BME280_I2C_SCL_PIN
        int "I2C SCL Pin"
        default 14
        help
            GPIO number for I2C master clock

    config TEMPY_BME280_I2C_ADDRESS
        hex "BME280 I2C address"
        default 0x76
        help
            7-bit I2C address for the BME280. Many modules use 0x76 when SDO
            is pulled low and 0x77 when SDO is pulled high.

    config TEMPY_TEMP_REPORT_HYSTERESIS_TENTHS_C
        int "Temperature report hysteresis (tenths of a degree Celsius)"
        default 2
        range 0 500
        help
            Minimum change in temperature required to trigger a Matter
            attribute update, expressed in 0.1 C units (e.g. 2 means
            0.2 C). A value of 0 disables hysteresis and reports every
            reading. Larger values save power by keeping the Thread radio
            asleep for more cycles, at the cost of coarser reporting.
            Matter's subscription MaxInterval still forces periodic
            reports during long stretches of stable readings.

    config TEMPY_HUMIDITY_REPORT_HYSTERESIS_TENTHS_PCT
        int "Humidity report hysteresis (tenths of a percent RH)"
        default 10
        range 0 1000
        help
            Minimum change in relative humidity required to trigger a
            Matter attribute update, expressed in 0.1 %RH units (e.g. 10
             means 1.0 %RH). A value of 0 disables hysteresis. See the
            temperature hysteresis help for further discussion.

endmenu
```
